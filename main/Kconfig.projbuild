## main/Kconfig.projbuild
```kconfig
menu "UART Configuration ESP32"

    config UART_PORT_NUM
        int "UART port number"
        range 0 2
        default 2
        help
            UART communication port number for the example.
            See UART documentation for available port numbers.

    config UART_BAUD_RATE
        int "UART communication speed"
        range 1200 115200
        default 115200
        help
            UART communication speed for Modbus example.

    config UART_RXD
        int "UART RXD pin number"
        default 16
        help
            GPIO number for UART RX pin. See UART documentation for more information
            about available pin numbers for UART.

    config UART_TXD
        int "UART TXD pin number"
        default 17
        help
            GPIO number for UART TX pin. See UART documentation for more information
            about available pin numbers for UART.
    
    config RX_BUFFER_SIZE
        int "UART RX ring buffer size"
        default 1024
    
    config TX_BUFFER_SIZE
        int "UART TX ring buffer size"
        default 0
        help
            If set to zero, driver will not use TX buffer,
            TX function will block task until all data have been sent out.

endmenu

menu "Parameters of communication protocol between PC and MCU"
    config SIZE_OF_ELEMENTS_PDU
        int "size elements of protocol data unit [byte]"
        default 4

    config IS_LSB
        int "switch between MSB (Most Significant Bit) and LSB (Least Significant Bit)"
        default 0
endmenu

menu "GPIO pin of on-Board LED"
    config GPIO_OF_ON_BOARD_LED
        int "GPIO number"
        default 2
        help 
            The on-board LED on most ESP32 development boards is connected to GPIO 2
endmenu

menu "LEDC config"
    config LEDC_TIMER_NUM
        int "h_timerx"
        default 2

    config LEDC_CHANNEL_NUM
        int "hschn"
        default 2       
endmenu

menu "ADC config"
    config FRAME_SIZE
        int "frame_size"
        default 20

    config SAMPLE_FREQ_HZ
        int "sample_freq_hz"
        default 100000       
endmenu
```
